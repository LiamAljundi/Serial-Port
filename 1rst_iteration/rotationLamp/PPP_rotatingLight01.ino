
/*

*/
#include <EduIntro.h>

int led1[]= {4, 5};
int led2[]= {6, 10};
int led3[]= {11, 12};


/*int LightGroup2[]= 
int LightGroup3[]=*/

Potentiometer pot(A5);

int brightnessVal = 0;

int pinCount = 2;  


void setup() {
   Serial.begin(9600);
  
    for (int i = 0; i < pinCount; i++) {
    pinMode(led1[i], OUTPUT);
    pinMode(led2[i], OUTPUT);
    pinMode(led3[i], OUTPUT);
  }
}

void loop() {
  
    brightnessVal = pot.read();
    
    for (int i = 0; i < pinCount; i++) {
    
    if( brightnessVal > 300)
    // turn the pin on:
    digitalWrite(led1[i], HIGH);

    else  
    // turn the pin off:
    digitalWrite(led1[i], LOW);
    };
    
   for (int i = 0; i < pinCount; i++) {
    
    if( brightnessVal > 650)
    // turn the pin on:
    digitalWrite(led2[i], HIGH);

    else  
    // turn the pin off:
    digitalWrite(led2[i], LOW);
    };
    
    
   for (int i = 0; i < pinCount; i++) {
    
    if( brightnessVal > 950)
    // turn the pin on:
    digitalWrite(led3[i], HIGH);

    else  
    // turn the pin off:
    digitalWrite(led3[i], LOW);
    };
    


    
    
}

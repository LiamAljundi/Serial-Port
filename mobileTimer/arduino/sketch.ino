
/*

*/
#include <EduIntro.h>
int connection= 8;
int connectionState = 0;

int ledRed[]= {4, 5};
int ledGreen[]= {6, 7};

Potentiometer pot(A5);
int brightnessVal = 0;

int pinCount = 2;  

unsigned long startMillis;  
unsigned long currentMillis;

const unsigned long periodA = 1000*60*60;
const unsigned long periodB = 1000*60*120; 
const unsigned long periodC = 1000*60*180; 

void setup() {
   Serial.begin(9600);
  
    pinMode(connection, INPUT);
    
    for (int i = 0; i < pinCount; i++) {
    pinMode(ledRed[i], OUTPUT);
    pinMode(ledGreen[i], OUTPUT);
    }
    
    startMillis = millis();
    
}

void loop() {
  
    brightnessVal = pot.read();
    connectionState = digitalRead(connection);
    currentMillis = millis();
    
    while(connectionState==HIGH && brightnessVal > 300){
      for (int i = 0; i < pinCount; i++) {
        digitalWrite(ledGreen[i], HIGH);
        startMillis = currentMillis;
      }
    }
      
    if(currentMillis - startMillis =< periodA && connectionState==LOW){
      for (int i = 0; i < pinCount; i++) {
        digitalWrite(ledRed[i], LOW);
        startMillis = currentMillis;
      }
    }
 
          
        
        //Add something to signal for a break

       for (int i = 0; i < pinCount; i++) {
        if( brightnessVal > 600){
        digitalWrite(ledGreen[i], HIGH);
        delay(timerB)}
        //Add something to signal for a break
      }
      
      for (int i = 0; i < pinCount; i++) {
        if( brightnessVal > 900){
        digitalWrite(ledGreen[i], HIGH);
        delay(timerC)}
        //Add something to signal for a break
      }
      
    
    



    
    
}
